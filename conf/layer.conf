## conf/layer.conf
```bitbake
# We have a conf directory, append to BBPATH
BBPATH .= ":${LAYERDIR}"

# We have a recipes directory, add to BBFILES
BBFILES += "${LAYERDIR}/recipes-*/*/*.bb ${LAYERDIR}/recipes-*/*/*.bbappend"

BBFILE_COLLECTIONS += "alico"
BBFILE_PATTERN_alico := "^${LAYERDIR}/"
BBFILE_PRIORITY_alico = "6"
```

## conf/machine/alico.conf
```bitbake
#@TYPE: Machine
#@NAME: Alico Kinetic 
#@DESCRIPTION: Machine configuration for the http://alicosystems.com/ Kinetic boards

include conf/machine/include/alico-base.inc

UBOOT_MACHINE = "omap3_alico_config"
```

## conf/machine/include/alico-base.inc
```bitbake
# Provides the Alico Kinetic common settings

include conf/machine/include/alico-default-providers.inc

# Add u-boot image to rootfs
EXTRA_IMAGEDEPENDS = "u-boot-alico"

# Specify kernel image type
KERNEL_IMAGETYPE = "uImage"

# Specify machine features
MACHINE_FEATURES = "kernel26 apm usbgadget usbhost vfat"

# Ship kernel modules
MACHINE_EXTRA_RRECOMMENDS = "kernel-modules"

# Specify rootfs image filesystem types
IMAGE_FSTYPES += "jffs2 ext2.gz tar.bz2"

# Specify serial console settings
SERIAL_CONSOLE = "115200 tty02"
```

## conf/machine/include/alico-default-providers.inc
```bitbake
# Alico Kinetic 3530 BSP default providers

PREFERRED_PROVIDER_virtual/kernel ?= "linux-omap"
PREFERRED_PROVIDER_u-boot ?= "u-boot-omap3"
PREFERRED_PROVIDER_x-load ?= "x-load-omap3"
```
